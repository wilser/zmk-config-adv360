macro_ewtest1: macro_ewtest1{
    compatible = "zmk,behavior-macro";
    label = "EricFirstLabel";
    #binding-cells = <0>; #does this mean comment?
    bindings = <&kp SHIFT>, <&kp T>, <&kp SHIFT>, <&kp H>, <&kp I>, <&kp S>, <&kp SPACE>, <&kp i>, <&kp s>,  <&kp a>,  <&kp t>, <&kp e>, <&kp s>, <&kp t>;
}




macro_ex_quotes: macro_ex_quotes{
compatible = "zmk,behavior-macro";
label = "Adv360Ex_macro_quotes";
#binding-cells = <0>;
bindings = <&kp SQT>, <&kp SQT>, <&kp LEFT>;
};

macro_kinesis: macro_kinesis{
compatible = "zmk,behavior-macro";
label = "macro_kinesis";
#binding-cells = <0>;
bindings = <&kp K>, <&kp I>, <&kp N>, <&kp E>, <&kp S>, <&kp I>, <&kp S>;
};

